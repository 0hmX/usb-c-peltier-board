#include "display.h"
#include <string.h>

#define OLED_ADDRESS (0x3Cu << 1)
/* Five-column glyphs, bit0 at the top. Only the UI's uppercase characters. */
static const uint8_t letters[][5] = {
  {0x7E,0x11,0x11,0x11,0x7E}, {0x7F,0x49,0x49,0x49,0x36},
  {0x3E,0x41,0x41,0x41,0x22}, {0x7F,0x41,0x41,0x22,0x1C},
  {0x7F,0x49,0x49,0x49,0x41}, {0x7F,0x09,0x09,0x09,0x01},
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  {0x07,0x08,0x70,0x08,0x07}, {0x61,0x51,0x49,0x45,0x43}
};
static const uint8_t digits[][5] = {
  {0x3E,0x51,0x49,0x45,0x3E}, {0x00,0x42,0x7F,0x40,0x00},
  {0x42,0x61,0x51,0x49,0x46}, {0x21,0x41,0x45,0x4B,0x31},
  {0x18,0x14,0x12,0x7F,0x10}, {0x27,0x45,0x45,0x45,0x39},
  {0x3C,0x4A,0x49,0x49,0x30}, {0x01,0x71,0x09,0x05,0x03},
  {0x36,0x49,0x49,0x49,0x36}, {0x06,0x49,0x49,0x29,0x1E}
};

static void glyph(char c, uint8_t *pixels) {
  if (c >= 'A' && c <= 'Z') memcpy(pixels, letters[c - 'A'], 5);
  else if (c >= '0' && c <= '9') memcpy(pixels, digits[c - '0'], 5);
  else if (c == '.') pixels[2] = 0x60;
  else if (c == '-') memset(pixels, 0x08, 5);
  else if (c == '>') { pixels[1] = 0x22; pixels[2] = 0x14; pixels[3] = 0x08; }
  else if (c == '~') { pixels[0] = 0x08; pixels[1] = 0x04; pixels[2] = 0x08; pixels[3] = 0x10; pixels[4] = 0x08; }
}

bool display_init(I2C_HandleTypeDef *bus) {
  /* SSD1306, 128x32, page mode, internal charge pump; Waveshare SKU14657. */
  uint8_t commands[] = {0x00,0xAE,0xD5,0x80,0xA8,0x1F,0xD3,0x00,0x40,
    0x8D,0x14,0x20,0x02,0xA1,0xC8,0xDA,0x02,0x81,0x7F,0xD9,0xF1,
    0xDB,0x40,0xA4,0xA6,0xAF};
  return HAL_I2C_Master_Transmit(bus, OLED_ADDRESS, commands, sizeof commands, 10) == HAL_OK;
}

bool display_lines(I2C_HandleTypeDef *bus, const char *lines[4]) {
  for (uint8_t page = 0; page < 4; ++page) {
    uint8_t position[] = {0x00, (uint8_t)(0xB0u | page), 0x00, 0x10};
    uint8_t pixels[129] = {0x40};
    for (unsigned column = 0; column < 21 && lines[page][column]; ++column)
      glyph(lines[page][column], &pixels[1 + column * 6]);
    if (HAL_I2C_Master_Transmit(bus, OLED_ADDRESS, position, sizeof position, 10) != HAL_OK ||
        HAL_I2C_Master_Transmit(bus, OLED_ADDRESS, pixels, sizeof pixels, 20) != HAL_OK) return false;
  }
  return true;
}
